## conf/layer.conf
```bitbake
# We have a conf and classes directory, append to BBPATH
BBPATH .= ":${LAYERDIR}"

# We have a recipes directory, add to BBFILES
BBFILES += "${LAYERDIR}/recipes*/*/*.bb ${LAYERDIR}/recipes*/*/*.bbappend ${LAYERDIR}/images/*.bb"

BBFILE_COLLECTIONS += "meta-syntro"
BBFILE_PATTERN_meta-syntro := "^${LAYERDIR}/"
BBFILE_PRIORITY_meta-syntro = "10"

LAYERSERIES_COMPAT_meta-syntro = "rocko sumo thud"
```
